/********************************************************************/
/**********************12864显示程序*********************************/
/**********************二○○九年七月二十九日二十时十四分************/
/**********************显示一个美女，呵呵********************/
/********************************************************************/

#include <REG52.h>
#include <stdio.h>
#include <intrins.h>

#define uchar unsigned char 
#define uint  unsigned int
#define D_12864 P0
#define H       1
#define L       0
//#define C_
/*++++++++++++++++++++++++++++++++++++++++++++++++*/
//#define 
/*++++++++++++++++++++++++++++++++++++++++++++++++*/
sbit RS_12864   =P2^0;	   //RS
sbit RW_12864   =P2^1;   //RW
sbit E_12864    =P2^2;   //E
sbit PSB_12864  =P2^3;
sbit RESET_12864=P2^5;
sbit NC         =P2^4;
sbit TestLED=P2^1;
/*
sbit RST=P1^7;
sbit PSB=P1^6;
sbit EN=P1^5;
sbit RW=P1^4;
sbit RS=P1^3;
*/
//************************************************
/*-----------------------------------------*/

char code code1[]="这是第一行";
char code code2[]="这是第二行";
char code code3[]="这是第三行";
char code code4[]="这是第四行";
char code pic[]={
0x00,0x00,0x03,0xFF,0xFF,0xFF,0xFF,0xFF,0xFF,0xFF,0xFF,0xFF,0xFE,0x00,0x00,0x00,
0x00,0x00,0x07,0xFF,0xFF,0xFF,0xFF,0xFF,0xFF,0xFF,0xFF,0xFF,0xFF,0x00,0x00,0x00,
0x00,0x00,0x07,0xFF,0xFF,0xFF,0xFF,0xFF,0xFF,0xFF,0xFF,0xFF,0xFF,0x00,0x00,0x00,
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0x00,0x00,0x00,0x00,0x03,0x00,0x00,0x00,0x00,0x00,0x01,0x80,0x00,0x00,0x00,0x00
};
//======================子程序声明
void  Delay7us(uchar times);
void  Delay5ms(uchar times);
void WriteInst(uchar,bit);			//写指令到指令暂存器（ＩＲ）函数  Rs=L;RW=L
void WriteData(char Data);		//写数据到数据暂存器　　　　　　      RS=H;RW=L　　　　
uchar ReadData(void);			//读出数据						      RS=H;RW=H
uchar ReadBusy(void);				//读忙　及地址记数器（ＡＣ）的状态    RS=L;RW=H
void TestBusy(void);
void Init12864(void);
void AutoDischar(char *p,uchar ,uchar); //显示字符程序，给字符首地址以及坐标点X：0~8,Y：1~4
void MakePic(char *p);
// void DisALine(char *p,uchar x,uchar y);
/*-----------------------------------------*/
/*********************************************/
void main(void){
	 char *p;
	 PSB_12864=1;
	 Init12864();
	  p=&pic;
	 MakePic(p); 
	 while(1){
/*
//	 TestLED=~TestLED;
//	 Delay5ms(100);
	 p=&code1;
	 AutoDischar(p,0,1);
	 p=&code2;
	 AutoDischar(p,0,2);
	 p=&code3;
	 AutoDischar(p,0,3);
	 p=&code4;
	 AutoDischar(p,0,4);  
*/
	 }
}
/**************************************************/
/*-----------------------------------------*/
//===========================================
void Delay5ms(uchar times){
	uchar i,k;
	for(;times>0;times--)
		for(i=10;i>0;i--)
			for(k=250;k>0;k--);
}
//===========================================
void Delay7us(uchar times){
	for(;times;times--){
		_nop_();
	}
}
/*-----------------------------------------------*/
//==============================
void WriteInst(uchar Inst,bit b){
	if(b)TestBusy();
	RS_12864=L;
	RW_12864=L;
//	_nop_();
	E_12864 =H;
//	_nop_();
    D_12864 =Inst;
	E_12864 =L;
//	_nop_();
}
uchar ReadBusy(void){
	uchar Busy_8;
	D_12864=0xFF;
	RS_12864=L;
	RW_12864=H;
	_nop_();
	E_12864 =H;
	_nop_();
	Busy_8=D_12864; 
	E_12864 =L;
	_nop_();
	D_12864=0xFF;
	RS_12864=L;
	RW_12864=H;
	_nop_();
	E_12864 =H;
	_nop_();
	Busy_8=D_12864; 
	E_12864 =L;
	_nop_();
	return Busy_8;
}
void TestBusy(void){
	bit b=0;
	uchar busy;
	do{
	busy=ReadBusy();
	b=(bit)(busy&0x80);
	}while(b);
}
void WriteData(char Data){
	TestBusy();
	RS_12864=H;
	RW_12864=L;
//	_nop_();
	E_12864 =H;
//	_nop_();
	D_12864=Data;
	E_12864 =L;
//	_nop_();
}
uchar ReadData(void){
	uchar Data;
	RS_12864=H;
	RW_12864=H;
	_nop_();
	E_12864 =H;
	_nop_();
	Data=D_12864;
	E_12864 =L;
	_nop_();
	return Data;
}
//=======================================
void Init12864(void){
	Delay5ms(8);
	RESET_12864=L;
	Delay5ms(1);
	RESET_12864=H;
	Delay5ms(1);
	WriteInst(0X38,0);
	Delay5ms(2);
	WriteInst(0X38,0);
	Delay5ms(2);
	WriteInst(0X38,0);
	Delay5ms(2);
	WriteInst(0x38,1);
	WriteInst(0X08,1);
	WriteInst(0X01,1);
	WriteInst(0X06,1);
	WriteInst(0X0c,1);
}
//===========================================
void AutoDischar(char *p,uchar x,uchar y){
	uchar yy;
	if(y==1)yy=0;
	else if(y==2)yy=0x10;
	else if(y==3)yy=0x08;
	else yy=0x18;
	WriteInst(0x80|x|yy,1);
	while(*p!='\0'){
		WriteData(*p++);
	}
}
void MakePic(char *p){
	uchar i;
	uchar j;
	WriteInst(0x34,1);
	for(j=0;j<32;j++){
			WriteInst(0x80|j,1);
			WriteInst(0x80,1);
			for(i=0;i<16;i++)WriteData(*p++);
	}
	for(j=0;j<32;j++){
			WriteInst(0x80|j,1);
			WriteInst(0x88,1);
			for(i=0;i<16;i++)WriteData(*p++);
	}
	WriteInst(0x36,1);
}
/*
void DisALine(char *p,uchar x,uchar y){
	WriteInst(0x34,1);
} 
*/